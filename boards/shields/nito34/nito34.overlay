/ {
    chosen {
        zmk,kscan = &kscan0;
    };

    kscan0: kscan {
        compatible = "zmk,kscan-gpio-matrix";
        label = "KSCAN";
        diode-direction = "col2row";

        row-gpios
            = <&gpio0 31 (GPIO_ACTIVE_HIGH | GPIO_PULL_DOWN)>  // P0.31
            , <&gpio0 29 (GPIO_ACTIVE_HIGH | GPIO_PULL_DOWN)>  // P0.29
            , <&gpio0 2  (GPIO_ACTIVE_HIGH | GPIO_PULL_DOWN)>  // P0.02
            , <&gpio1 15 (GPIO_ACTIVE_HIGH | GPIO_PULL_DOWN)>  // P1.15
            ;

        col-gpios
            = <&gpio0 17 GPIO_ACTIVE_HIGH>  // P0.17
            , <&gpio0 20 GPIO_ACTIVE_HIGH>  // P0.20
            , <&gpio0 22 GPIO_ACTIVE_HIGH>  // P0.22
            , <&gpio0 24 GPIO_ACTIVE_HIGH>  // P0.24
            , <&gpio1 0  GPIO_ACTIVE_HIGH>  // P1.00
            , <&gpio0 11 GPIO_ACTIVE_HIGH>  // P0.11
            , <&gpio1 4  GPIO_ACTIVE_HIGH>  // P1.04
            , <&gpio1 6  GPIO_ACTIVE_HIGH>  // P1.06
            , <&gpio1 11  GPIO_ACTIVE_HIGH>  // P1.11
            , <&gpio1 13  GPIO_ACTIVE_HIGH>  // P1.13
            ;
    };
};
